/* 设备树节点示例 */
led_test {
    compatible = "fire,led";
    
    led {
        led-pin = <7>;
        led-active-low;
        /* reg属性在父节点或这里定义 */
    };
};

/* 或者更简洁的方式 */
led_test {
    compatible = "fire,led";
    reg = <0xfdd60000 0x1000>;
    led-pin = <7>;
    led-active-low;
};